/dts-v1/;

/ {

	fragment@0 {
		target-path = "/fpga-full";

		__overlay__ {
			ranges;
			compatible = "simple-bus";
			#address-cells = <0x01>;
			#size-cells = <0x01>;
			firmware-name = "design_1_wrapper_pynq_z1.bit.bin";

			clocking0 {
				compatible = "xlnx,fclk";
				assigned-clocks = <0xffffffff 0x0f>;
				assigned-clock-rates = <0x5f5e100>;
				#clock-cells = <0x00>;
				clock-output-names = "fabric_clk";
				clocks = <0xffffffff 0x0f>;
				phandle = <0x01>;
			};

			afi0@f8008000 {
				status = "okay";
				compatible = "xlnx,zynq-afi-fpga";
				#address-cells = <0x01>;
				reg = <0xf8008000 0x1000>;
				#size-cells = <0x00>;
				xlnx,afi-width = <0x01>;
				phandle = <0x02>;
			};

			cgra_axi_lite@43c00000 {
				interrupts = <0x00 0x1d 0x04>;
				compatible = "xlnx,cgra-axi-lite-1.0";
				interrupt-parent = <0xffffffff>;
				xlnx,rable = <0x00>;
				xlnx,s00-axi-data-width = <0x20>;
				xlnx,ip-name = "cgra_axi_lite";
				reg = <0x43c00000 0x10000>;
				xlnx,m00-axi-target-slave-base-addr = <0x40000000>;
				clocks = <0xffffffff 0x0f 0xffffffff 0x0f 0xffffffff 0x0f>;
				xlnx,m00-axi-addr-width = <0x20>;
				xlnx,edk-iptype = "PERIPHERAL";
				status = "okay";
				clock-names = "clk_i\0m00_axi_aclk\0s00_axi_aclk";
				xlnx,s00-axi-addr-width = <0x20>;
				interrupt-names = "int_line_shared";
				xlnx,m00-axi-data-width = <0x20>;
				xlnx,m00-axi-start-data-value = <0xaa000000>;
				xlnx,name = "cgra_axi_lite_0";
				phandle = <0x03>;
			};
		};
	};

	__symbols__ {
		clocking0 = "/fragment@0/__overlay__/clocking0";
		afi0 = "/fragment@0/__overlay__/afi0@f8008000";
		cgra_axi_lite_0 = "/fragment@0/__overlay__/cgra_axi_lite@43c00000";
	};

	__fixups__ {
		clkc = "/fragment@0/__overlay__/clocking0:assigned-clocks:0\0/fragment@0/__overlay__/clocking0:clocks:0\0/fragment@0/__overlay__/cgra_axi_lite@43c00000:clocks:0\0/fragment@0/__overlay__/cgra_axi_lite@43c00000:clocks:8\0/fragment@0/__overlay__/cgra_axi_lite@43c00000:clocks:16";
		intc = "/fragment@0/__overlay__/cgra_axi_lite@43c00000:interrupt-parent:0";
	};
};
